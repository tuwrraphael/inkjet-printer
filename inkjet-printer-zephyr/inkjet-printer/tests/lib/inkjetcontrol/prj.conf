## CMakeLists.txt
```
cmake_minimum_required(VERSION 3.20.0)
find_package(Zephyr REQUIRED HINTS $ENV{ZEPHYR_BASE})
project(app_lib_inkjetcontrol_test)

target_sources(app PRIVATE src/once_per_tick.c)
target_sources(app PRIVATE src/once_per_x_ticks.c)
target_sources(app PRIVATE src/x_per_tick.c)
target_sources(app PRIVATE src/x_per_x_ticks.c)
target_sources(app PRIVATE src/test_pattern.c)
target_sources(app PRIVATE src/lines_to_print.c)
```

## prj.conf
```kconfig
CONFIG_ZTEST=y
CONFIG_ZTEST_NEW_API=y
CONFIG_LOG=y
CONFIG_INKJETCONTROL=y
CONFIG_INKJETCONTROL_LOG_LEVEL_DBG=y
```

## src/main.c
```c
#include <limits.h>

#include <zephyr/ztest.h>

#include <lib/inkjetcontrol.h>

static uint32_t encoder_value = 0;
static uint32_t fire_abort_called = 0;

uint32_t get_value(void)
{
	return encoder_value;
}

void fire_abort(void)
{
	fire_abort_called = 1;
	return;
}

static void before(void *f)
{
	encoder_value = 0;
	fire_abort_called = 0;
}

static void encoder_advance(encoder_print_status_t *status, int32_t ticks)
{
	uint16_t ticks_pos = ticks < 0 ? -ticks : ticks;
	for (uint16_t i = 0; i < ticks_pos; i++)
	{
		encoder_value += ticks < 0 ? -1 : 1;
		encoder_tick_handler(status);
	}
}

ZTEST(inkjet_lib, test_normal_operation)
{
	encoder_print_init_t init = {
		.get_value = get_value,
		.fire_abort = fire_abort,
		.sequential_fires = 1,
		.fire_every_ticks = 1,
		.first_line_after_encoder_position = 3};

	encoder_print_status_t encoder_print_status;

	encoder_print_init(&encoder_print_status, &init);
	encoder_advance(&encoder_print_status, 1);
	zassert_equal(fire_abort_called, 1, "fire_abort not called after 1 tick");
}

ZTEST_SUITE(inkjet_lib, NULL, NULL, before, NULL, NULL);
```

## src/lines_to_print.c
```c
#include <limits.h>

#include <zephyr/ztest.h>

#include <lib/inkjetcontrol/encoder.h>

static int32_t encoder_value = 0;
static uint32_t fire_abort_called = 0;
static int32_t load_line_called_with = 0;
static bool last_fire_aborted = false;

static int32_t get_value(void *inst)
{
    return encoder_value;
}

static void fire_abort(void *inst)
{
    fire_abort_called++;
    last_fire_aborted = true;
    return;
}

static void error_cb_fail_test(void *inst)
{
	printf("Error callback called\n");
	ztest_test_fail();
}

static void load_line(void *inst, uint32_t line, bool wait_fired)
{
	load_line_called_with = line;
	encoder_print_status_t *encoder_print_status = (encoder_print_status_t *)inst;
	encoder_signal_load_line_completed(encoder_print_status, line);
	return;
}
static void before(void *f)
{
    encoder_value = 0;
    fire_abort_called = 0;
    load_line_called_with = -1;
    last_fire_aborted = false;
}

#define MAX_FIRE_LOOP (20)

static void fire_until_aborted(encoder_print_status_t *status)
{
    uint32_t fire_loop = 0;
    while (!last_fire_aborted)
    {
        if (fire_loop >= MAX_FIRE_LOOP)
        {
            break;
            printf("fire_loop >= MAX_FIRE_LOOP");
            ztest_test_fail();
        }
        encoder_fire_issued_handler(status);
        encoder_fire_cycle_completed_handler(status);
        fire_loop++;
    }
    last_fire_aborted = false;
}

static void encoder_advance(encoder_print_status_t *status, int32_t ticks)
{
    uint16_t ticks_pos = ticks < 0 ? -ticks : ticks;
    for (uint16_t i = 0; i < ticks_pos; i++)
    {
        encoder_value += ticks < 0 ? -1 : 1;
        encoder_tick_handler(status);
        fire_until_aborted(status);
    }
}

ZTEST(encoder_lines_to_print, test_prints_no_lines)
{
    encoder_print_status_t encoder_print_status;
    encoder_print_init_t init = {
        .get_value = get_value,
        .fire_abort = fire_abort,
        .load_line = load_line,
        .load_error_cb = error_cb_fail_test,
        .inst = &encoder_print_status,
        .sequential_fires = 1,
        .fire_every_ticks = 1,
        .lines_to_print = 0,
        .print_first_line_after_encoder_tick = 1};

    encoder_print_init(&encoder_print_status, &init);
    encoder_advance(&encoder_print_status, 1); // -- encoder 1
    zassert_equal(encoder_print_status.last_printed_line, -1, "something was printed");
    encoder_advance(&encoder_print_status, 1); // -- encoder 2
    zassert_equal(encoder_print_status.last_printed_line, -1, "something was printed");
    zassert_equal(encoder_print_status.printed_lines, 0, "printed lines not 0");
}

ZTEST(encoder_lines_to_print, test_prints_two_lines)
{
    encoder_print_status_t encoder_print_status;
    encoder_print_init_t init = {
        .get_value = get_value,
        .fire_abort = fire_abort,
        .load_line = load_line,
        .load_error_cb = error_cb_fail_test,
        .inst = &encoder_print_status,
        .sequential_fires = 1,
        .fire_every_ticks = 1,
        .lines_to_print = 2,
        .print_first_line_after_encoder_tick = 1};

    encoder_print_init(&encoder_print_status, &init);
    encoder_advance(&encoder_print_status, 1); // -- encoder 1
    zassert_equal(encoder_print_status.last_printed_line, 0, "last_printed_line not 0");
    encoder_advance(&encoder_print_status, 1); // -- encoder 2
    zassert_equal(encoder_print_status.last_printed_line, 1, "last_printed_line not 1");
    zassert_equal(encoder_print_status.printed_lines, 2, "printed lines not 2");
    encoder_advance(&encoder_print_status, 1); // -- encoder 3
    zassert_equal(encoder_print_status.last_printed_line, 1, "last_printed_line not 1");
    zassert_equal(encoder_print_status.printed_lines, 2, "printed lines not 2");
}


ZTEST_SUITE(encoder_lines_to_print, NULL, NULL, before, NULL, NULL);
```

## src/once_per_tick.c
```c
#include <limits.h>

#include <zephyr/ztest.h>

#include <lib/inkjetcontrol/encoder.h>

static int32_t encoder_value = 0;
static uint32_t fire_abort_called = 0;
static int32_t load_line_called_with = 0;
static bool last_fire_aborted = false;

static int32_t get_value(void *inst)
{
	return encoder_value;
}

static void error_cb_fail_test(void *inst)
{
	printf("Error callback called\n");
	ztest_test_fail();
}

static void fire_abort(void *inst)
{
	fire_abort_called++;
	last_fire_aborted = true;
	return;
}

static void load_line(void *inst, uint32_t line, bool wait_fired)
{
	load_line_called_with = line;
	encoder_print_status_t *encoder_print_status = (encoder_print_status_t *)inst;
	encoder_signal_load_line_completed(encoder_print_status, line);
	return;
}

static void before(void *f)
{
	encoder_value = 0;
	fire_abort_called = 0;
	load_line_called_with = -1;
	last_fire_aborted = false;
}

static void fire_if_not_aborted(encoder_print_status_t *status)
{
	if (!last_fire_aborted)
	{
		encoder_fire_issued_handler(status);
		encoder_fire_cycle_completed_handler(status);
	}
	last_fire_aborted = false;
}

static void encoder_advance(encoder_print_status_t *status, int32_t ticks)
{
	uint16_t ticks_pos = ticks < 0 ? -ticks : ticks;
	for (uint16_t i = 0; i < ticks_pos; i++)
	{
		encoder_value += ticks < 0 ? -1 : 1;
		encoder_tick_handler(status);
		fire_if_not_aborted(status);
	}
}

ZTEST(encoder_print_once_per_tick, test_not_printing_before_first_line_when_negative)
{
	encoder_print_status_t encoder_print_status;

	encoder_print_init_t init = {
		.get_value = get_value,
		.fire_abort = fire_abort,
		.load_line = load_line,
		.load_error_cb = error_cb_fail_test,
		.inst = &encoder_print_status,
		.sequential_fires = 1,
		.fire_every_ticks = 1,
		.lines_to_print = 1000,
		.print_first_line_after_encoder_tick = 4};

	encoder_print_init(&encoder_print_status, &init);
	encoder_advance(&encoder_print_status, -3);
	zassert_equal(encoder_print_status.last_printed_line, -1, "last_printed_line not -1");
	zassert_equal(encoder_print_status.expected_encoder_value, init.print_first_line_after_encoder_tick, "last_printed_line not -1");
	encoder_advance(&encoder_print_status, 6);
	zassert_equal(encoder_print_status.last_printed_line, -1, "last_printed_line not -1");
	encoder_advance(&encoder_print_status, 1);
	zassert_equal(encoder_print_status.last_printed_line, 0, "last_printed_line not 0");
	zassert_equal(encoder_value, 4, "encoder_value not 4");
}

ZTEST(encoder_print_once_per_tick, test_not_printing_before_first_line)
{
	encoder_print_status_t encoder_print_status;
	encoder_print_init_t init = {
		.get_value = get_value,
		.fire_abort = fire_abort,
		.load_line = load_line,
		.load_error_cb = error_cb_fail_test,
		.inst = &encoder_print_status,
		.sequential_fires = 1,
		.fire_every_ticks = 1,
		.lines_to_print = 1000,
		.print_first_line_after_encoder_tick = 4};

	encoder_print_init(&encoder_print_status, &init);
	encoder_advance(&encoder_print_status, 1);
	zassert_equal(fire_abort_called, 1, "fire_abort not called after 1 tick");
	encoder_advance(&encoder_print_status, 2);
	zassert_equal(fire_abort_called, 3, "fire_abort called after 2 ticks");
	zassert_equal(encoder_print_status.last_printed_line, -1, "last_printed_line not -1");
}

ZTEST(encoder_print_once_per_tick, test_normal_operation)
{
	encoder_print_status_t encoder_print_status;
	encoder_print_init_t init = {
		.get_value = get_value,
		.fire_abort = fire_abort,
		.load_line = load_line,
		.load_error_cb = error_cb_fail_test,
		.inst = &encoder_print_status,
		.sequential_fires = 1,
		.fire_every_ticks = 1,
		.lines_to_print = 1000,
		.print_first_line_after_encoder_tick = 1};

	encoder_print_init(&encoder_print_status, &init);
	encoder_advance(&encoder_print_status, 1);
	zassert_equal(encoder_print_status.last_printed_line, 0, "last_printed_line not 0");
	encoder_advance(&encoder_print_status, 1);
	zassert_equal(encoder_print_status.last_printed_line, 1, "last_printed_line not 0");
	zassert_equal(encoder_print_status.printed_lines, 2, "printed_lines not 2");
}

ZTEST(encoder_print_once_per_tick, test_prints_first_line_pos_5)
{
	encoder_print_status_t encoder_print_status;
	encoder_print_init_t init = {
		.get_value = get_value,
		.fire_abort = fire_abort,
		.load_line = load_line,
		.load_error_cb = error_cb_fail_test,
		.inst = &encoder_print_status,
		.sequential_fires = 1,
		.fire_every_ticks = 1,
		.lines_to_print = 1000,
		.print_first_line_after_encoder_tick = 5};

	encoder_print_init(&encoder_print_status, &init);
	encoder_advance(&encoder_print_status, 4);
	zassert_equal(fire_abort_called, 4, "fire_abort not called after 3 ticks");
	zassert_equal(encoder_print_status.last_printed_line, -1, "last_printed_line not 0");
	encoder_advance(&encoder_print_status, 1);
	zassert_equal(encoder_print_status.last_printed_line, 0, "last_printed_line not 0");
}

ZTEST(encoder_print_once_per_tick, test_encoder_jitter_back)
{
	encoder_print_status_t encoder_print_status;
	encoder_print_init_t init = {
		.get_value = get_value,
		.fire_abort = fire_abort,
		.load_line = load_line,
		.load_error_cb = error_cb_fail_test,
		.inst = &encoder_print_status,
		.sequential_fires = 1,
		.fire_every_ticks = 1,
		.lines_to_print = 1000,
		.print_first_line_after_encoder_tick = 1};

	encoder_print_init(&encoder_print_status, &init);
	encoder_value++;
	encoder_tick_handler(&encoder_print_status);
	encoder_value--;
	encoder_tick_handler(&encoder_print_status);
	encoder_value++;
	encoder_tick_handler(&encoder_print_status);
	fire_if_not_aborted(&encoder_print_status);
	zassert_equal(encoder_print_status.last_printed_line, 0, "last_printed_line not 0");
	zassert_equal(fire_abort_called, 1, "fire_abort not called 1 time");
}

ZTEST(encoder_print_once_per_tick, test_missed_single_tick)
{
	encoder_print_status_t encoder_print_status;
	encoder_print_init_t init = {
		.get_value = get_value,
		.fire_abort = fire_abort,
		.load_line = load_line,
		.load_error_cb = error_cb_fail_test,
		.inst = &encoder_print_status,
		.sequential_fires = 1,
		.fire_every_ticks = 1,
		.lines_to_print = 1000,
		.print_first_line_after_encoder_tick = 1};

	encoder_print_init(&encoder_print_status, &init);
	encoder_value++;
	encoder_tick_handler(&encoder_print_status); // -- encoder 1 (plan to print 0)
	encoder_value++;
	encoder_tick_handler(&encoder_print_status); // -- encoder 2 (plan to print 1), not printed 0 yet jump forward
	fire_if_not_aborted(&encoder_print_status);
	zassert_equal(encoder_print_status.last_printed_line, 0, "last_printed_line not 0");
	zassert_equal(fire_abort_called, 1, "fire_abort not called 1 time");
	encoder_value++;
	encoder_tick_handler(&encoder_print_status); // -- encoder 3 (plan to print 2), detect
	fire_if_not_aborted(&encoder_print_status);
	zassert_equal(encoder_print_status.last_printed_line, 0, "last_printed_line not 0");
	zassert_equal(fire_abort_called, 2, "fire_abort not called after jump detected");
	zassert_equal(load_line_called_with, 3, "load_line not called with 3");
	zassert_equal(encoder_print_status.lost_lines_count, 2, "lost_lines_count not 2");
	zassert_equal(encoder_print_status.lost_lines[0], 1, "lost_lines[0] not 1");
	zassert_equal(encoder_print_status.lost_lines[1], 2, "lost_lines[1] not 2");
	encoder_advance(&encoder_print_status, 1); // -- encoder 4 (plan to print 3)
	zassert_equal(encoder_print_status.last_printed_line, 3, "last_printed_line not 3");
	encoder_advance(&encoder_print_status, 1); // -- encoder 5 (plan to print 4)
	zassert_equal(encoder_print_status.last_printed_line, 4, "last_printed_line not 4");
}

ZTEST(encoder_print_once_per_tick, test_missed_two_ticks)
{
	encoder_print_status_t encoder_print_status;
	encoder_print_init_t init = {
		.get_value = get_value,
		.fire_abort = fire_abort,
		.load_line = load_line,
		.load_error_cb = error_cb_fail_test,
		.inst = &encoder_print_status,
		.sequential_fires = 1,
		.fire_every_ticks = 1,
		.lines_to_print = 1000,
		.print_first_line_after_encoder_tick = 1};

	encoder_print_init(&encoder_print_status, &init);
	encoder_value++;
	encoder_tick_handler(&encoder_print_status); // -- encoder 1 (plan to print 0)
	encoder_value++;
	encoder_tick_handler(&encoder_print_status); // -- encoder 2 (plan to print 1), not printed yet jump forward
	encoder_value++;
	encoder_tick_handler(&encoder_print_status); // -- encoder 3 (plan to print 2), not printed yet jump forward
	fire_if_not_aborted(&encoder_print_status);
	zassert_equal(encoder_print_status.last_printed_line, 0, "last_printed_line not 0");
	zassert_equal(fire_abort_called, 1, "fire_abort not called 1 time");
	encoder_value++;
	encoder_tick_handler(&encoder_print_status); // -- encoder 4 (plan to print 3), detect
	fire_if_not_aborted(&encoder_print_status);
	zassert_equal(encoder_print_status.last_printed_line, 0, "last_printed_line not 0");
	zassert_equal(fire_abort_called, 2, "fire_abort not called after jump detected");
	zassert_equal(load_line_called_with, 4, "load_line not called with 4");
	zassert_equal(encoder_print_status.lost_lines_count, 3, "lost_lines_count not 3");
	zassert_equal(encoder_print_status.lost_lines[0], 1, "lost_lines[0] not 1");
	zassert_equal(encoder_print_status.lost_lines[1], 2, "lost_lines[1] not 2");
	zassert_equal(encoder_print_status.lost_lines[2], 3, "lost_lines[2] not 3");
	encoder_advance(&encoder_print_status, 1); // -- encoder 5 (plan to print 4)
	zassert_equal(encoder_print_status.last_printed_line, 4, "last_printed_line not 4");
}

static void load_error_cb_print(void *inst)
{
	printf("Error callback called\n");
}

static void load_line_manual_complete(void *inst, uint32_t line, bool wait_fired)
{
	load_line_called_with = line;
	return;
}

// static void fire_if_not_aborted(encoder_print_status_t *status)
// {
// 	if (!last_fire_aborted)
// 	{
// 		encoder_fire_issued_handler(status);
// 		encoder_fire_cycle_completed_handler(status);
// 	}
// 	last_fire_aborted = false;
// }

// static void encoder_advance(encoder_print_status_t *status, int32_t ticks)
// {
// 	uint16_t ticks_pos = ticks < 0 ? -ticks : ticks;
// 	for (uint16_t i = 0; i < ticks_pos; i++)
// 	{
// 		encoder_value += ticks < 0 ? -1 : 1;
// 		encoder_tick_handler(status);
// 		fire_if_not_aborted(status);
// 	}
// }

ZTEST(encoder_print_once_per_tick, load_line_slow)
{
	encoder_print_status_t encoder_print_status;
	encoder_print_init_t init = {
		.get_value = get_value,
		.fire_abort = fire_abort,
		.load_line = load_line_manual_complete,
		.load_error_cb = load_error_cb_print,
		.inst = &encoder_print_status,
		.sequential_fires = 1,
		.fire_every_ticks = 1,
		.lines_to_print = 1000,
		.print_first_line_after_encoder_tick = 1};

	encoder_print_init(&encoder_print_status, &init);
	encoder_signal_load_line_completed(&encoder_print_status, 0);
	encoder_advance(&encoder_print_status, 1);
	zassert_equal(fire_abort_called, 1, "fire_abort not called 1 time");
	encoder_signal_load_line_completed(&encoder_print_status, 1);
	zassert_equal(encoder_print_status.last_printed_line, 0, "last_printed_line not 0");
	encoder_value++;
	encoder_tick_handler(&encoder_print_status);
	encoder_fire_issued_handler(&encoder_print_status);
	zassert_equal(encoder_print_status.last_line_queued_for_loading, 2, "last_line_queued_for_loading not 2");
	encoder_fire_cycle_completed_handler(&encoder_print_status);
	zassert_equal(encoder_print_status.last_printed_line, 1, "last_printed_line not 1");
	encoder_value++;
	zassert_equal(fire_abort_called, 2, "fire_abort not called 2 times");
	encoder_tick_handler(&encoder_print_status);
	encoder_signal_load_line_completed(&encoder_print_status, 2);
	zassert_equal(fire_abort_called, 3, "fire_abort not called 3 times");
	encoder_value++;
	encoder_tick_handler(&encoder_print_status);
	zassert_equal(fire_abort_called, 4, "fire_abort not called 4 times");
	printf("fire abort called %d times\n", fire_abort_called);
	zassert_equal(load_line_called_with, 4, "load_line not called with 4");
	zassert_equal(encoder_print_status.lost_lines_count, 2, "lost_lines_count not 2");
	zassert_equal(encoder_print_status.lost_lines[0], 2, "lost_lines[0] not 2");
	zassert_equal(encoder_print_status.lost_lines[1], 3, "lost_lines[1] not 3");
	encoder_signal_load_line_completed(&encoder_print_status, 4);
	last_fire_aborted = false;
	encoder_advance(&encoder_print_status, 1);
	zassert_equal(encoder_print_status.last_printed_line, 4, "last_printed_line not 4");
}

ZTEST_SUITE(encoder_print_once_per_tick, NULL, NULL, before, NULL, NULL);
```

## src/once_per_x_ticks.c
```c
#include <limits.h>

#include <zephyr/ztest.h>

#include <lib/inkjetcontrol/encoder.h>

static int32_t encoder_value = 0;
static uint32_t fire_abort_called = 0;
static int32_t load_line_called_with = 0;
static bool last_fire_aborted = false;

static int32_t get_value(void *inst)
{
	return encoder_value;
}

static void fire_abort(void *inst)
{
	fire_abort_called++;
	last_fire_aborted = true;
	return;
}

static void error_cb_fail_test(void *inst)
{
	printf("Error callback called\n");
	ztest_test_fail();
}

static void load_line(void *inst, uint32_t line, bool wait_fired)
{
	load_line_called_with = line;
	encoder_print_status_t *encoder_print_status = (encoder_print_status_t *)inst;
	encoder_signal_load_line_completed(encoder_print_status, line);
	return;
}

static void before(void *f)
{
	encoder_value = 0;
	fire_abort_called = 0;
	load_line_called_with = -1;
	last_fire_aborted = false;
}

#define MAX_FIRE_LOOP (20)

static void fire_until_aborted(encoder_print_status_t *status)
{
	uint32_t fire_loop = 0;
	while (!last_fire_aborted)
	{
		if (fire_loop >= MAX_FIRE_LOOP)
		{
			break;
			printf("fire_loop >= MAX_FIRE_LOOP");
			ztest_test_fail();
		}
		encoder_fire_issued_handler(status);
		encoder_fire_cycle_completed_handler(status);
		fire_loop++;
	}
	last_fire_aborted = false;
}

static void encoder_advance(encoder_print_status_t *status, int32_t ticks)
{
	uint16_t ticks_pos = ticks < 0 ? -ticks : ticks;
	for (uint16_t i = 0; i < ticks_pos; i++)
	{
		encoder_value += ticks < 0 ? -1 : 1;
		encoder_tick_handler(status);
		fire_until_aborted(status);
	}
}

ZTEST(encoder_print_once_x_ticks, test_not_printing_before_first_line)
{
	encoder_print_status_t encoder_print_status;
	encoder_print_init_t init = {
		.get_value = get_value,
		.fire_abort = fire_abort,
		.load_line = load_line,
		.load_error_cb = error_cb_fail_test,
		.inst = &encoder_print_status,
		.sequential_fires = 1,
		.fire_every_ticks = 3,
		.lines_to_print = 1000,
		.print_first_line_after_encoder_tick = 7};

	encoder_print_init(&encoder_print_status, &init);
	encoder_advance(&encoder_print_status, 6);
	zassert_equal(fire_abort_called, 6, "fire_abort not called for first 6 ticks");
	zassert_equal(encoder_print_status.last_printed_line, -1, "last_printed_line not -1");
	encoder_advance(&encoder_print_status, 1);
	zassert_equal(encoder_print_status.last_printed_line, 0, "last_printed_line not 0");
}

ZTEST(encoder_print_once_x_ticks, test_normal_operation)
{
	uint32_t cases[] = {2, 3, 4};
	for (uint32_t casenr = 0; casenr < sizeof(cases) / sizeof(cases[0]); casenr++)
	{
		before(NULL);
		uint32_t fire_every_ticks = cases[casenr];
		encoder_print_status_t encoder_print_status;
		encoder_print_init_t init = {
			.get_value = get_value,
			.fire_abort = fire_abort,
			.load_line = load_line,
			.load_error_cb = error_cb_fail_test,
			.inst = &encoder_print_status,
			.sequential_fires = 1,
			.fire_every_ticks = fire_every_ticks,
			.lines_to_print = 1000,
			.print_first_line_after_encoder_tick = 2};

		encoder_print_init(&encoder_print_status, &init);
		encoder_advance(&encoder_print_status, 1);
		zassert_equal(encoder_print_status.last_printed_line, -1, "last_printed_line not -1");
		encoder_advance(&encoder_print_status, 1);
		zassert_equal(encoder_print_status.last_printed_line, 0, "last_printed_line not 0");
		uint32_t printed = 0;
		for (int i = 0; i < 3; i++)
		{
			for (int j = 0; j < fire_every_ticks - 1; j++)
			{
				encoder_advance(&encoder_print_status, 1);
				zassert_equal(encoder_print_status.last_printed_line, printed + i, "last_printed_line not matched");
			}
			encoder_advance(&encoder_print_status, 1);
			zassert_equal(encoder_print_status.last_printed_line, printed + i + 1, "last_printed_line not matched (3)");
		}
	}
}

ZTEST(encoder_print_once_x_ticks, test_encoder_fire_after_skip)
{
	encoder_print_status_t encoder_print_status;
	encoder_print_init_t init = {
		.get_value = get_value,
		.fire_abort = fire_abort,
		.load_line = load_line,
		.load_error_cb = error_cb_fail_test,
		.inst = &encoder_print_status,
		.sequential_fires = 1,
		.fire_every_ticks = 3,
		.lines_to_print = 1000,
		.print_first_line_after_encoder_tick = 1};

	encoder_print_init(&encoder_print_status, &init);
	encoder_value++;
	encoder_tick_handler(&encoder_print_status); // -- encoder 1 /print0
	encoder_value++;
	encoder_tick_handler(&encoder_print_status); // -- encoder 2
	encoder_value++;
	encoder_tick_handler(&encoder_print_status); // -- encoder 3
	// now print 0
	zassert_equal(encoder_print_status.last_printed_line, -1, "last_printed_line not -1");
	fire_until_aborted(&encoder_print_status);
	zassert_equal(encoder_print_status.last_printed_line, 0, "last_printed_line not 0");
	encoder_advance(&encoder_print_status, 1); // -- encoder 4 /print1
	zassert_equal(encoder_print_status.last_printed_line, 1, "last_printed_line not 1");
}

ZTEST(encoder_print_once_x_ticks, test_every2_missed_tick)
{
	encoder_print_status_t encoder_print_status;
	encoder_print_init_t init = {
		.get_value = get_value,
		.fire_abort = fire_abort,
		.load_line = load_line,
		.load_error_cb = error_cb_fail_test,
		.inst = &encoder_print_status,
		.sequential_fires = 1,
		.fire_every_ticks = 2,
		.lines_to_print = 1000,
		.print_first_line_after_encoder_tick = 1};

	encoder_print_init(&encoder_print_status, &init);
	encoder_advance(&encoder_print_status, 1); // -- encoder 1 (print 0)
	zassert_equal(encoder_print_status.last_printed_line, 0, "last_printed_line not 0");
	encoder_advance(&encoder_print_status, 1); // -- encoder 2
	zassert_equal(encoder_print_status.last_printed_line, 0, "last_printed_line not 0");
	encoder_value++;
	encoder_tick_handler(&encoder_print_status); // -- encoder 3 (plan to print 1)
	encoder_value++;
	encoder_tick_handler(&encoder_print_status); // -- encoder 4 (planned skip)
	encoder_value++;
	encoder_tick_handler(&encoder_print_status); // -- encoder 5 (plan to print 2)
	fire_until_aborted(&encoder_print_status);	 // -- fire finished late (before 5 would be ok)
	encoder_advance(&encoder_print_status, 1);	 // -- encoder 6 (planned skip), detect
	zassert_equal(encoder_print_status.last_printed_line, 1, "last_printed_line not 1");
	zassert_equal(load_line_called_with, 3, "load_line not called with 3");
	zassert_equal(encoder_print_status.lost_lines_count, 1, "lost_lines_count not 1");
	zassert_equal(encoder_print_status.lost_lines[0], 2, "lost_lines[0] not 2");
	encoder_advance(&encoder_print_status, 1); // -- encoder 7 (plan to print 3)
	zassert_equal(encoder_print_status.last_printed_line, 3, "last_printed_line not 3");
}

ZTEST(encoder_print_once_x_ticks, test_every2_missed_tick_late)
{
	encoder_print_status_t encoder_print_status;
	encoder_print_init_t init = {
		.get_value = get_value,
		.fire_abort = fire_abort,
		.load_line = load_line,
		.load_error_cb = error_cb_fail_test,
		.inst = &encoder_print_status,
		.sequential_fires = 1,
		.fire_every_ticks = 2,
		.lines_to_print = 1000,
		.print_first_line_after_encoder_tick = 1};

	encoder_print_init(&encoder_print_status, &init);
	encoder_advance(&encoder_print_status, 1); // -- encoder 1 (print 0)
	zassert_equal(encoder_print_status.last_printed_line, 0, "last_printed_line not 0");
	encoder_advance(&encoder_print_status, 1); // -- encoder 2
	zassert_equal(encoder_print_status.last_printed_line, 0, "last_printed_line not 0");
	encoder_value++;
	encoder_tick_handler(&encoder_print_status); // -- encoder 3 (plan to print 1)
	encoder_value++;
	encoder_tick_handler(&encoder_print_status); // -- encoder 4 (planned skip)
	encoder_value++;
	encoder_tick_handler(&encoder_print_status); // -- encoder 5 (plan to print 2)
	encoder_advance(&encoder_print_status, 1);	 // -- encoder 6 (planned skip), fire finished late
	encoder_advance(&encoder_print_status, 1);	 // -- encoder 7 (plan to print 3), detect
	zassert_equal(encoder_print_status.last_printed_line, 1, "last_printed_line not 1");
	zassert_equal(load_line_called_with, 4, "load_line not called with 4");
	zassert_equal(encoder_print_status.lost_lines_count, 2, "lost_lines_count not 2");
	zassert_equal(encoder_print_status.lost_lines[0], 2, "lost_lines[0] not 2");
	zassert_equal(encoder_print_status.lost_lines[1], 3, "lost_lines[1] not 3");
	encoder_advance(&encoder_print_status, 1); // -- encoder 8 (planned skip)
	zassert_equal(encoder_print_status.last_printed_line, 1, "last_printed_line not 3");
	encoder_advance(&encoder_print_status, 1); // -- encoder 9 (plan to print 4)
	zassert_equal(encoder_print_status.last_printed_line, 4, "last_printed_line not 4");
}

ZTEST(encoder_print_once_x_ticks, test_every3_missed_tick)
{
	encoder_print_status_t encoder_print_status;
	encoder_print_init_t init = {
		.get_value = get_value,
		.fire_abort = fire_abort,
		.load_line = load_line,
		.load_error_cb = error_cb_fail_test,
		.inst = &encoder_print_status,
		.sequential_fires = 1,
		.fire_every_ticks = 3,
		.lines_to_print = 1000,
		.print_first_line_after_encoder_tick = 1};

	encoder_print_init(&encoder_print_status, &init);
	encoder_value++;
	encoder_tick_handler(&encoder_print_status); // -- encoder 1 (plan to print 0)
	encoder_value++;
	encoder_tick_handler(&encoder_print_status); // -- encoder 2 (planned skip)
	encoder_value++;
	encoder_tick_handler(&encoder_print_status); // -- encoder 3 (planned skip)
	zassert_equal(encoder_print_status.last_printed_line, -1, "last_printed_line not -1");
	encoder_advance(&encoder_print_status, 1); // -- encoder 4 (plan to print 1) print 0
	zassert_equal(encoder_print_status.last_printed_line, 0, "last_printed_line not 0");
	encoder_advance(&encoder_print_status, 1); // -- encoder 5 (planned skip) detect
	zassert_equal(encoder_print_status.last_printed_line, 0, "last_printed_line not 1");
	zassert_equal(load_line_called_with, 2, "load_line not called with 2");
	zassert_equal(encoder_print_status.lost_lines_count, 1, "lost_lines_count not 1");
	zassert_equal(encoder_print_status.lost_lines[0], 1, "lost_lines[0] not 1");
	encoder_advance(&encoder_print_status, 1); // -- encoder 6 (planned skip)
	zassert_equal(encoder_print_status.last_printed_line, 0, "last_printed_line not 0");
	encoder_advance(&encoder_print_status, 1); // -- encoder 7 (plan to print 2)
	zassert_equal(encoder_print_status.last_printed_line, 2, "last_printed_line not 2");
}

ZTEST_SUITE(encoder_print_once_x_ticks, NULL, NULL, before, NULL, NULL);
```

## src/test_pattern.c
```c
#include <limits.h>

#include <zephyr/ztest.h>

#include <lib/inkjetcontrol/test_pattern.h>

ZTEST(test_pattern, test_get_nozzle_zig_zag)
{
    zassert_equal(get_nozzle_zig_zag(0), 127, "get_nozzle_zig_zag(0) should return 127");
    zassert_equal(get_nozzle_zig_zag(1), 126, "get_nozzle_zig_zag(1) should return 126");
    zassert_equal(get_nozzle_zig_zag(2), 125, "get_nozzle_zig_zag(1) should return 125");
    zassert_equal(get_nozzle_zig_zag(127), 0, "get_nozzle_zig_zag(127) should return 0");
    zassert_equal(get_nozzle_zig_zag(128), 0, "get_nozzle_zig_zag(128) should return 0");
    zassert_equal(get_nozzle_zig_zag(129), 1, "get_nozzle_zig_zag(129) should return 1");
    zassert_equal(get_nozzle_zig_zag(130), 2, "get_nozzle_zig_zag(130) should return 2");
    zassert_equal(get_nozzle_zig_zag(255), 127, "get_nozzle_zig_zag(255) should return 127");
    zassert_equal(get_nozzle_zig_zag(256), 127, "get_nozzle_zig_zag(256) should return 127");
    zassert_equal(get_nozzle_zig_zag(257), 126, "get_nozzle_zig_zag(257) should return 126");
}

ZTEST_SUITE(test_pattern, NULL, NULL, NULL, NULL, NULL);
```

## src/x_per_tick.c
```c
#include <limits.h>

#include <zephyr/ztest.h>

#include <lib/inkjetcontrol/encoder.h>

static int32_t encoder_value = 0;
static uint32_t fire_abort_called = 0;
static int32_t load_line_called_with = 0;
static bool last_fire_aborted = false;

static int32_t get_value(void *inst)
{
    return encoder_value;
}

static void fire_abort(void *inst)
{
    fire_abort_called++;
    last_fire_aborted = true;
    return;
}

static void error_cb_fail_test(void *inst)
{
    printf("Error callback called\n");
    ztest_test_fail();
}

static void load_line(void *inst, uint32_t line, bool wait_fired)
{
    load_line_called_with = line;
    encoder_print_status_t *encoder_print_status = (encoder_print_status_t *)inst;
    encoder_signal_load_line_completed(encoder_print_status, line);
    return;
}
static void before(void *f)
{
    encoder_value = 0;
    fire_abort_called = 0;
    load_line_called_with = -1;
    last_fire_aborted = false;
}

#define MAX_FIRE_LOOP (20)

static void fired_handler(encoder_print_status_t *status)
{
    encoder_fire_issued_handler(status);
    encoder_fire_cycle_completed_handler(status);
}

static void fire_until_aborted(encoder_print_status_t *status)
{
    uint32_t fire_loop = 0;
    while (!last_fire_aborted)
    {
        if (fire_loop >= MAX_FIRE_LOOP)
        {
            break;
            printf("fire_loop >= MAX_FIRE_LOOP");
            ztest_test_fail();
        }
        fired_handler(status);
        fire_loop++;
    }
    last_fire_aborted = false;
}

static void encoder_advance(encoder_print_status_t *status, int32_t ticks)
{
    uint16_t ticks_pos = ticks < 0 ? -ticks : ticks;
    for (uint16_t i = 0; i < ticks_pos; i++)
    {
        encoder_value += ticks < 0 ? -1 : 1;
        encoder_tick_handler(status);
        fire_until_aborted(status);
    }
}

ZTEST(encoder_print_x_per_tick, test_normal_operation)
{
        encoder_print_status_t encoder_print_status;
    encoder_print_init_t init = {
        .get_value = get_value,
        .fire_abort = fire_abort,
        .load_line = load_line,
        .load_error_cb = error_cb_fail_test,
        .inst = &encoder_print_status,
        .sequential_fires = 2,
        .fire_every_ticks = 1,
        .lines_to_print = 1000,
        .print_first_line_after_encoder_tick = 1};

    encoder_print_init(&encoder_print_status, &init);
    encoder_advance(&encoder_print_status, 1);
    zassert_equal(encoder_print_status.last_printed_line, 1, "last_printed_line not 1");
    encoder_advance(&encoder_print_status, 1);
    zassert_equal(encoder_print_status.last_printed_line, 3, "last_printed_line not 3");
}

ZTEST(encoder_print_x_per_tick, test_2x_missed_tick)
{    encoder_print_status_t encoder_print_status;
    encoder_print_init_t init = {
        .get_value = get_value,
        .fire_abort = fire_abort,
        .load_line = load_line,
        .load_error_cb = error_cb_fail_test,
        .inst = &encoder_print_status,
        .sequential_fires = 2,
        .fire_every_ticks = 1,
        .lines_to_print = 1000,
        .print_first_line_after_encoder_tick = 1};

    encoder_print_init(&encoder_print_status, &init);
    encoder_value++;
    encoder_tick_handler(&encoder_print_status); // -- encoder 1 (plan to print 0 and 1)
    fired_handler(&encoder_print_status);
    zassert_equal(last_fire_aborted, false, "last_fire_aborted not false");
    encoder_value++;
    encoder_tick_handler(&encoder_print_status); // -- encoder 2 (plan to print 2 and 3)
    fired_handler(&encoder_print_status);
    zassert_equal(last_fire_aborted, true, "last_fire_aborted not true");
    encoder_value++;
    encoder_tick_handler(&encoder_print_status); // -- encoder 3 (plan to print 4 and 5), detect
    zassert_equal(encoder_print_status.last_printed_line, 1, "last_printed_line not 1");
    zassert_equal(load_line_called_with, 6, "load_line not called with 6");
    zassert_equal(encoder_print_status.lost_lines_count, 4, "lost_lines_count not 4");
    zassert_equal(encoder_print_status.lost_lines[0], 2, "lost_lines[0] not 2");
    zassert_equal(encoder_print_status.lost_lines[1], 3, "lost_lines[1] not 3");
    zassert_equal(encoder_print_status.lost_lines[2], 4, "lost_lines[2] not 4");
    zassert_equal(encoder_print_status.lost_lines[3], 5, "lost_lines[3] not 5");
    encoder_value++;
    encoder_tick_handler(&encoder_print_status); // -- encoder 4 (plan to print 6 and 7)
    fired_handler(&encoder_print_status);
    zassert_equal(encoder_print_status.last_printed_line, 6, "last_printed_line not 6");
    fired_handler(&encoder_print_status);
    zassert_equal(encoder_print_status.last_printed_line, 7, "last_printed_line not 7");
}

ZTEST_SUITE(encoder_print_x_per_tick, NULL, NULL, before, NULL, NULL);
```

## src/x_per_x_ticks.c
```c
#include <limits.h>

#include <zephyr/ztest.h>

#include <lib/inkjetcontrol/encoder.h>

static int32_t encoder_value = 0;
static uint32_t fire_abort_called = 0;
static int32_t load_line_called_with = 0;
static bool last_fire_aborted = false;

static int32_t get_value(void *inst)
{
    return encoder_value;
}

static void fire_abort(void *inst)
{
    fire_abort_called++;
    last_fire_aborted = true;
    return;
}

static void error_cb_fail_test(void *inst)
{
	printf("Error callback called\n");
	ztest_test_fail();
}

static void load_line(void *inst, uint32_t line, bool wait_fired)
{
	load_line_called_with = line;
	encoder_print_status_t *encoder_print_status = (encoder_print_status_t *)inst;
	encoder_signal_load_line_completed(encoder_print_status, line);
	return;
}
static void before(void *f)
{
    encoder_value = 0;
    fire_abort_called = 0;
    load_line_called_with = -1;
    last_fire_aborted = false;
}

#define MAX_FIRE_LOOP (20)

static void fire_until_aborted(encoder_print_status_t *status)
{
    uint32_t fire_loop = 0;
    while (!last_fire_aborted)
    {
        if (fire_loop >= MAX_FIRE_LOOP)
        {
            break;
            printf("fire_loop >= MAX_FIRE_LOOP");
            ztest_test_fail();
        }
        encoder_fire_issued_handler(status);
        encoder_fire_cycle_completed_handler(status);
        fire_loop++;
    }
    last_fire_aborted = false;
}

static void encoder_advance(encoder_print_status_t *status, int32_t ticks)
{
    uint16_t ticks_pos = ticks < 0 ? -ticks : ticks;
    for (uint16_t i = 0; i < ticks_pos; i++)
    {
        encoder_value += ticks < 0 ? -1 : 1;
        encoder_tick_handler(status);
        fire_until_aborted(status);
    }
}

ZTEST(encoder_print_x_per_x_ticks, test_270dpi_normal_operation)
{
    encoder_print_status_t encoder_print_status;
    encoder_print_init_t init = {
        .get_value = get_value,
        .fire_abort = fire_abort,
        .load_line = load_line,
        .load_error_cb = error_cb_fail_test,
        .inst = &encoder_print_status,
        .sequential_fires = 3,
        .fire_every_ticks = 2,
        .lines_to_print = 1000,
        .print_first_line_after_encoder_tick = 1};

    encoder_print_init(&encoder_print_status, &init);
    encoder_advance(&encoder_print_status, 1); // -- encoder 1 (plan to print 0, 1, 2)
    zassert_equal(encoder_print_status.last_printed_line, 2, "last_printed_line not 2");
    encoder_advance(&encoder_print_status, 1); // -- encoder 2 (skip)
    zassert_equal(encoder_print_status.last_printed_line, 2, "last_printed_line not 2");
    encoder_advance(&encoder_print_status, 1); // -- encoder 3 (plan to print 3, 4, 5)
    zassert_equal(encoder_print_status.last_printed_line, 5, "last_printed_line not 5");
}

ZTEST(encoder_print_x_per_x_ticks, test_270dpi_missed_tick)
{
    encoder_print_status_t encoder_print_status;
    encoder_print_init_t init = {
        .get_value = get_value,
        .fire_abort = fire_abort,
        .load_line = load_line,
        .load_error_cb = error_cb_fail_test,
        .inst = &encoder_print_status,
        .sequential_fires = 3,
        .fire_every_ticks = 2,
        .lines_to_print = 1000,
        .print_first_line_after_encoder_tick = 1};

    encoder_print_init(&encoder_print_status, &init);
    encoder_value++;
    encoder_tick_handler(&encoder_print_status); // -- encoder 1 (plan to print 0, 1, 2)
    encoder_value++;
    encoder_tick_handler(&encoder_print_status); // -- encoder 2 (skip)
    encoder_advance(&encoder_print_status, 1);   // -- encoder 3 (plan to print 3, 4, 5)
    zassert_equal(encoder_print_status.last_printed_line, 2, "last_printed_line not 2");
    encoder_advance(&encoder_print_status, 1); // -- encoder 4 (skip), detect
    zassert_equal(encoder_print_status.last_printed_line, 2, "last_printed_line not 2");
    zassert_equal(load_line_called_with, 6, "load_line not called with 7");
    zassert_equal(encoder_print_status.lost_lines_count, 3, "lost_lines_count not 3");
    zassert_equal(encoder_print_status.lost_lines[0], 3, "lost_lines[0] not 3");
    zassert_equal(encoder_print_status.lost_lines[1], 4, "lost_lines[1] not 4");
    zassert_equal(encoder_print_status.lost_lines[2], 5, "lost_lines[2] not 5");
    encoder_advance(&encoder_print_status, 1); // -- encoder 5 (plan to print 6, 7, 8)
    zassert_equal(encoder_print_status.last_printed_line, 8, "last_printed_line not 8");
}

ZTEST_SUITE(encoder_print_x_per_x_ticks, NULL, NULL, before, NULL, NULL);
```
