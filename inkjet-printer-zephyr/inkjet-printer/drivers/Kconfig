## inkjet-printer-zephyr/inkjet-printer/drivers/Kconfig
```kconfig
menu "Drivers"
rsource "printer/Kconfig"
rsource "sensor/Kconfig"
rsource "motor/Kconfig"
rsource "adc/Kconfig"
rsource "dac/Kconfig"
endmenu
```

## inkjet-printer-zephyr/inkjet-printer/drivers/adc/mcp3021/Kconfig
```kconfig
config ADC_MCP3021
	bool "ADC MCP3021"
	default y
	depends on DT_HAS_MCP_MCP3021_ENABLED
	select I2C
	help
	  Enable MCP3021 ADC
```

## inkjet-printer-zephyr/inkjet-printer/drivers/motor/Kconfig
```kconfig
menuconfig MOTOR
	bool "Motor drivers"
	help
	  Include motor drivers in system config

if MOTOR

module = MOTOR
module-str = motor
source "subsys/logging/Kconfig.template.log_config"

config MOTOR_INIT_PRIORITY
	int "Motor init priority"
	default 90
	help
	  Motor initialization priority.

rsource "tb6612fng/Kconfig"
endif # MOTOR
```

## inkjet-printer-zephyr/inkjet-printer/drivers/motor/tb6612fng/Kconfig
```kconfig
config TB6612FNG
	bool "TB6612FNG Motor driver"
	default y
	depends on DT_HAS_TOSHIBA_TB6612FNG_ENABLED
	help
	  Enable TB6612FNG Motor Driver
```

## inkjet-printer-zephyr/inkjet-printer/drivers/printer/Kconfig
```kconfig
# Copyright (c) 2021 Nordic Semiconductor ASA
# SPDX-License-Identifier: Apache-2.0

menuconfig PRINTER
	bool "Printer drivers"
	help
	  Include printer drivers in system config

if PRINTER

module = PRINTER
module-str = printer
source "subsys/logging/Kconfig.template.log_config"

config PRINTER_INIT_PRIORITY
	int "Printer init priority"
	default 90
	help
	  Printer initialization priority.

rsource "xaar128/Kconfig"
rsource "fire/Kconfig"
endif # PRINTER
```

## inkjet-printer-zephyr/inkjet-printer/drivers/printer/fire/Kconfig
```kconfig
# Copyright (c) 2021 Nordic Semiconductor ASA
# SPDX-License-Identifier: Apache-2.0

config FIRE_STM32_COMBINED_PWM
	bool "STM32 combined PWM"
	default y
	depends on DT_HAS_ST_FIRE_STM32_COMBINED_PWM_ENABLED
	select USE_STM32_HAL_TIM
	select USE_STM32_HAL_TIM_EX
	help
	  Enable STM32 combined PWM drive for printer fire
```

## inkjet-printer-zephyr/inkjet-printer/drivers/printer/xaar128/Kconfig
```kconfig
# Copyright (c) 2021 Nordic Semiconductor ASA
# SPDX-License-Identifier: Apache-2.0

config XAAR128
	bool "Xaar 128 Printhead"
	default y
	depends on DT_HAS_XAAR_XAAR128_ENABLED
	select SPI
	help
	  Enable XAAR 128 Printhead Driver
```

## inkjet-printer-zephyr/inkjet-printer/drivers/sensor/Kconfig
```kconfig
if SENSOR
rsource "abp/Kconfig"
rsource "qdec_stm32_linear/Kconfig"
endif # SENSOR
```

## inkjet-printer-zephyr/inkjet-printer/drivers/sensor/abp/Kconfig
```kconfig
# Copyright (c) 2021 Nordic Semiconductor ASA
# SPDX-License-Identifier: Apache-2.0

config ABP_PRESSURE_SENSOR
	bool "ABP Pressure Sensor"
	default y
	depends on DT_HAS_HONEYWELL_ABP_ENABLED
	select SPI
	help
	  Enable Honeywell ABP Pressure Sensor
```

## inkjet-printer-zephyr/inkjet-printer/drivers/sensor/qdec_stm32_linear/Kconfig
```kconfig
config QDEC_STM32_LINEAR
	bool "STM32 QDEC driver with linear output"
	default y
	depends on DT_HAS_ST_STM32_QDEC_LINEAR_ENABLED
	select USE_STM32_LL_TIM
	help
	  STM32 family Quadrature Decoder driver with linear output

if QDEC_STM32_LINEAR

config QDEC_STM32_LINEAR_MAX_ENCODER_COUNT
	int "maximum encoder count"
	depends on QDEC_STM32_LINEAR
	default 10000

endif # QDEC_STM32_LINEAR
```

## inkjet-printer-zephyr/inkjet-printer/dts/bindings/adc/mcp,mcp3021.yaml
```yaml
# Copyright (c) 2023 Caspar Friedrich <c.s.w.friedrich@gmail.com>
# SPDX-License-Identifier: Apache-2.0

description: MCP3021

compatible: "mcp,mcp3021"

include: [i2c-device.yaml, adc-controller.yaml]

properties:
  "#io-channel-cells":
    const: 1
  ref-internal-mv:
    type: int
    required: true
    


io-channel-cells:
  - input
```

## inkjet-printer-zephyr/inkjet-printer/dts/bindings/motor/toshiba,tb6612fng.yaml
```yaml
description: |
  H Bridge Motor driver

compatible: "toshiba,tb6612fng"

include: [base.yaml]

properties:
  in1-gpios:
    type: phandle-array
    required: true
  in2-gpios:
    type: phandle-array
    required: true
  pwms:
    type: phandle-array
    required: true
```

## inkjet-printer-zephyr/inkjet-printer/dts/bindings/printer/st,fire_stm32_combined_pwm.yaml
```yaml
description: |
  STM32 combined PWM for printer fire signal

compatible: "st,fire-stm32-combined-pwm"

include: [base.yaml, pinctrl-device.yaml]

properties:
  pulse12_start:
    type: int
    required: true
  pulse34_start:
    type: int
    required: true
  pulse12_end:
    type: int
    required: true
  pulse34_end:
    type: int
    required: true
  min_mask_period:
    type: int
    required: true
  encoder_timer:
    type: phandle
    required: true
  encoder_timer_trigger:
    type: int
    required: true
    description:
      "TIM_TS_ITR3: Internal trigger 3"
  clock_timer_trigger:
    type: int
    required: true
    description:
      "TIM_TS_ITR0: Internal trigger 0"
  "#printer-fire-cells":
    const: 0
    type: int

# printer-fire-cells:
```

## inkjet-printer-zephyr/inkjet-printer/dts/bindings/printer/xaar,xaar128.yaml
```yaml
description: |
  Xaar 128 printhead driver

compatible: "xaar,xaar128"

include: spi-device.yaml

properties:
  pwms:
    required: true
    type: phandle-array
  nss1-gpios:
    type: phandle-array
    required: true
  nss2-gpios:
    type: phandle-array
    required: true
  ready-gpios:
    type: phandle-array
    required: true
  printer-fires:
    type: phandle-array
    required: true
```

## inkjet-printer-zephyr/inkjet-printer/dts/bindings/sensor/honeywell,abp.yaml
```yaml
description: |
    Honeywell ABP digital pressure sensor.

compatible: "honeywell,abp"

include: [sensor-device.yaml, spi-device.yaml]
```

## inkjet-printer-zephyr/inkjet-printer/lib/inkjetcontrol/Kconfig
```kconfig
config INKJETCONTROL
	bool "Support for inkjetcontrol library"
	help
	  This option enables the 'inkjetcontrol' library

if INKJETCONTROL

module = INKJETCONTROL
module-str = inkjetcontrol
source "subsys/logging/Kconfig.template.log_config"

endif # INKJETCONTROL
```

## inkjet-printer-zephyr/inkjet-printer/tests/lib/inkjetcontrol/testcase.yaml
```yaml
common:
  tags: extensibility
  integration_platforms:
    - native_posix
tests:
  lib.inkjetcontrol: {}
  lib.inkjetcontrol.non_default:
    extra_args: CONFIG_CUSTOM_GET_VALUE_DEFAULT=6
```
